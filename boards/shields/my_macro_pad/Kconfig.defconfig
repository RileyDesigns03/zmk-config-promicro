## boards/shields/my_macro_pad/Kconfig.defconfig
```kconfig
if SHIELD_MY_MACRO_PAD
    # Name must be less than 16 characters long!
    config ZMK_KEYBOARD_NAME
        default "MacroPad"
endif
```

## boards/shields/my_macro_pad/Kconfig.shield
```kconfig
# No whitespace after the comma or in your shield name!
config SHIELD_MY_MACRO_PAD
    def_bool $(shields_list_contains,my_macro_pad)
```
